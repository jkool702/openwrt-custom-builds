## openwrt-imagebuilder-qualcommax-ipq807x.Linux-x86_64/build_dir/target-aarch64_cortex-a53_musl/linux-qualcommax_ipq807x/xiaomi_ax9000-uImage.itb.its
```
/dts-v1/;

/ {
	description = "ARM64 OpenWrt FIT (Flattened Image Tree)";
	#address-cells = <1>;

	images {
		kernel-1 {
			description = "ARM64 OpenWrt Linux-6.6.30";
			data = /incbin/("/mnt/ramdisk/build/openwrt/build_dir/target-aarch64_cortex-a53_musl/linux-qualcommax_ipq807x/xiaomi_ax9000-uImage.itb");
			type = "kernel";
			arch = "arm64";
			os = "linux";
			compression = "gzip";
			load = <0x41000000>;
			entry = <0x41000000>;
			hash-1 {
				algo = "crc32";
			};
			hash-2 {
				algo = "sha1";
			};
		};


		fdt-1 {
			description = "ARM64 OpenWrt xiaomi_ax9000 device tree blob";
			
			data = /incbin/("/mnt/ramdisk/build/openwrt/build_dir/target-aarch64_cortex-a53_musl/linux-qualcommax_ipq807x/image-ipq8072-ax9000.dtb");
			type = "flat_dt";
			
			arch = "arm64";
			compression = "none";
			hash-1 {
				algo = "crc32";
			};
			hash-2 {
				algo = "sha1";
			};
		};



	};

	configurations {
		default = "config@hk14";
		config@hk14 {
			description = "OpenWrt xiaomi_ax9000";
			kernel = "kernel-1";
			fdt = "fdt-1";
			
			
			
		};
		
	};
};
```

## openwrt-imagebuilder-qualcommax-ipq807x.Linux-x86_64/build_dir/target-aarch64_cortex-a53_musl/linux-qualcommax_ipq807x/yuncore_ax880-uImage.itb.its
```
/dts-v1/;

/ {
	description = "ARM64 OpenWrt FIT (Flattened Image Tree)";
	#address-cells = <1>;

	images {
		kernel-1 {
			description = "ARM64 OpenWrt Linux-6.6.30";
			data = /incbin/("/mnt/ramdisk/build/openwrt/build_dir/target-aarch64_cortex-a53_musl/linux-qualcommax_ipq807x/yuncore_ax880-uImage.itb");
			type = "kernel";
			arch = "arm64";
			os = "linux";
			compression = "gzip";
			load = <0x41000000>;
			entry = <0x41000000>;
			hash-1 {
				algo = "crc32";
			};
			hash-2 {
				algo = "sha1";
			};
		};


		fdt-1 {
			description = "ARM64 OpenWrt yuncore_ax880 device tree blob";
			
			data = /incbin/("/mnt/ramdisk/build/openwrt/build_dir/target-aarch64_cortex-a53_musl/linux-qualcommax_ipq807x/image-ipq8072-ax880.dtb");
			type = "flat_dt";
			
			arch = "arm64";
			compression = "none";
			hash-1 {
				algo = "crc32";
			};
			hash-2 {
				algo = "sha1";
			};
		};



	};

	configurations {
		default = "config@hk09";
		config@hk09 {
			description = "OpenWrt yuncore_ax880";
			kernel = "kernel-1";
			fdt = "fdt-1";
			
			
			
		};
		
	};
};
```

## openwrt-imagebuilder-qualcommax-ipq807x.Linux-x86_64/build_dir/target-aarch64_cortex-a53_musl/linux-qualcommax_ipq807x/zbtlink_zbt-z800ax-uImage.itb.its
```
/dts-v1/;

/ {
	description = "ARM64 OpenWrt FIT (Flattened Image Tree)";
	#address-cells = <1>;

	images {
		kernel-1 {
			description = "ARM64 OpenWrt Linux-6.6.32";
			data = /incbin/("/mnt/ramdisk/build/openwrt/build_dir/target-aarch64_cortex-a53_musl/linux-qualcommax_ipq807x/zbtlink_zbt-z800ax-uImage.itb");
			type = "kernel";
			arch = "arm64";
			os = "linux";
			compression = "gzip";
			load = <0x41000000>;
			entry = <0x41000000>;
			hash-1 {
				algo = "crc32";
			};
			hash-2 {
				algo = "sha1";
			};
		};


		fdt-1 {
			description = "ARM64 OpenWrt zbtlink_zbt-z800ax device tree blob";
			
			data = /incbin/("/mnt/ramdisk/build/openwrt/build_dir/target-aarch64_cortex-a53_musl/linux-qualcommax_ipq807x/image-ipq8072-zbt-z800ax.dtb");
			type = "flat_dt";
			
			arch = "arm64";
			compression = "none";
			hash-1 {
				algo = "crc32";
			};
			hash-2 {
				algo = "sha1";
			};
		};



	};

	configurations {
		default = "config@hk09";
		config@hk09 {
			description = "OpenWrt zbtlink_zbt-z800ax";
			kernel = "kernel-1";
			fdt = "fdt-1";
			
			
			
		};
		
	};
};
```

## openwrt-imagebuilder-qualcommax-ipq807x.Linux-x86_64/build_dir/target-aarch64_cortex-a53_musl/linux-qualcommax_ipq807x/zte_mf269-uImage.itb.its
```
/dts-v1/;

/ {
	description = "ARM64 OpenWrt FIT (Flattened Image Tree)";
	#address-cells = <1>;

	images {
		kernel-1 {
			description = "ARM64 OpenWrt Linux-6.6.27";
			data = /incbin/("/mnt/ramdisk/build/openwrt/build_dir/target-aarch64_cortex-a53_musl/linux-qualcommax_ipq807x/zte_mf269-uImage.itb");
			type = "kernel";
			arch = "arm64";
			os = "linux";
			compression = "gzip";
			load = <0x41000000>;
			entry = <0x41000000>;
			hash-1 {
				algo = "crc32";
			};
			hash-2 {
				algo = "sha1";
			};
		};


		fdt-1 {
			description = "ARM64 OpenWrt zte_mf269 device tree blob";
			
			data = /incbin/("/mnt/ramdisk/build/openwrt/build_dir/target-aarch64_cortex-a53_musl/linux-qualcommax_ipq807x/image-ipq8071-mf269.dtb");
			type = "flat_dt";
			
			arch = "arm64";
			compression = "none";
			hash-1 {
				algo = "crc32";
			};
			hash-2 {
				algo = "sha1";
			};
		};



	};

	configurations {
		default = "config@ac04";
		config@ac04 {
			description = "OpenWrt zte_mf269";
			kernel = "kernel-1";
			fdt = "fdt-1";
			
			
			
		};
		
	};
};
```

## openwrt-imagebuilder-qualcommax-ipq807x.Linux-x86_64/build_dir/target-aarch64_cortex-a53_musl/linux-qualcommax_ipq807x/zyxel_nbg7815-uImage.itb.its
```
/dts-v1/;

/ {
	description = "ARM64 OpenWrt FIT (Flattened Image Tree)";
	#address-cells = <1>;

	images {
		kernel-1 {
			description = "ARM64 OpenWrt Linux-6.6.30";
			data = /incbin/("/mnt/ramdisk/build/openwrt/build_dir/target-aarch64_cortex-a53_musl/linux-qualcommax_ipq807x/zyxel_nbg7815-uImage.itb");
			type = "kernel";
			arch = "arm64";
			os = "linux";
			compression = "gzip";
			load = <0x41000000>;
			entry = <0x41000000>;
			hash-1 {
				algo = "crc32";
			};
			hash-2 {
				algo = "sha1";
			};
		};


		fdt-1 {
			description = "ARM64 OpenWrt zyxel_nbg7815 device tree blob";
			
			data = /incbin/("/mnt/ramdisk/build/openwrt/build_dir/target-aarch64_cortex-a53_musl/linux-qualcommax_ipq807x/image-ipq8074-nbg7815.dtb");
			type = "flat_dt";
			
			arch = "arm64";
			compression = "none";
			hash-1 {
				algo = "crc32";
			};
			hash-2 {
				algo = "sha1";
			};
		};



	};

	configurations {
		default = "config@nbg7815";
		config@nbg7815 {
			description = "OpenWrt zyxel_nbg7815";
			kernel = "kernel-1";
			fdt = "fdt-1";
			
			
			
		};
		
	};
};
```
