## openwrt-imagebuilder-qualcommax-ipq807x.Linux-x86_64/build_dir/target-aarch64_cortex-a53_musl/linux-qualcommax_ipq807x/buffalo_wxr-5950ax12-uImage.itb.its
```
/dts-v1/;

/ {
	description = "ARM64 OpenWrt FIT (Flattened Image Tree)";
	#address-cells = <1>;

	images {
		kernel-1 {
			description = "ARM64 OpenWrt Linux-6.6.27";
			data = /incbin/("/mnt/ramdisk/build/openwrt/build_dir/target-aarch64_cortex-a53_musl/linux-qualcommax_ipq807x/buffalo_wxr-5950ax12-uImage.itb");
			type = "kernel";
			arch = "arm64";
			os = "linux";
			compression = "gzip";
			load = <0x41000000>;
			entry = <0x41000000>;
			hash-1 {
				algo = "crc32";
			};
			hash-2 {
				algo = "sha1";
			};
		};


		fdt-1 {
			description = "ARM64 OpenWrt buffalo_wxr-5950ax12 device tree blob";
			
			data = /incbin/("/mnt/ramdisk/build/openwrt/build_dir/target-aarch64_cortex-a53_musl/linux-qualcommax_ipq807x/image-ipq8074-wxr-5950ax12.dtb");
			type = "flat_dt";
			
			arch = "arm64";
			compression = "none";
			hash-1 {
				algo = "crc32";
			};
			hash-2 {
				algo = "sha1";
			};
		};



	};

	configurations {
		default = "config@hk01";
		config@hk01 {
			description = "OpenWrt buffalo_wxr-5950ax12";
			kernel = "kernel-1";
			fdt = "fdt-1";
			
			
			
		};
		
	};
};
```

## openwrt-imagebuilder-qualcommax-ipq807x.Linux-x86_64/build_dir/target-aarch64_cortex-a53_musl/linux-qualcommax_ipq807x/cmcc_rm2-6-uImage.itb.its
```
/dts-v1/;

/ {
	description = "ARM64 OpenWrt FIT (Flattened Image Tree)";
	#address-cells = <1>;

	images {
		kernel-1 {
			description = "ARM64 OpenWrt Linux-6.6.32";
			data = /incbin/("/mnt/ramdisk/build/openwrt/build_dir/target-aarch64_cortex-a53_musl/linux-qualcommax_ipq807x/cmcc_rm2-6-uImage.itb");
			type = "kernel";
			arch = "arm64";
			os = "linux";
			compression = "gzip";
			load = <0x41000000>;
			entry = <0x41000000>;
			hash-1 {
				algo = "crc32";
			};
			hash-2 {
				algo = "sha1";
			};
		};


		fdt-1 {
			description = "ARM64 OpenWrt cmcc_rm2-6 device tree blob";
			
			data = /incbin/("/mnt/ramdisk/build/openwrt/build_dir/target-aarch64_cortex-a53_musl/linux-qualcommax_ipq807x/image-ipq8070-rm2-6.dtb");
			type = "flat_dt";
			
			arch = "arm64";
			compression = "none";
			hash-1 {
				algo = "crc32";
			};
			hash-2 {
				algo = "sha1";
			};
		};



	};

	configurations {
		default = "config@ac02";
		config@ac02 {
			description = "OpenWrt cmcc_rm2-6";
			kernel = "kernel-1";
			fdt = "fdt-1";
			
			
			
		};
		
	};
};
```

## openwrt-imagebuilder-qualcommax-ipq807x.Linux-x86_64/build_dir/target-aarch64_cortex-a53_musl/linux-qualcommax_ipq807x/compex_wpq873-uImage.itb.its
```
/dts-v1/;

/ {
	description = "ARM64 OpenWrt FIT (Flattened Image Tree)";
	#address-cells = <1>;

	images {
		kernel-1 {
			description = "ARM64 OpenWrt Linux-6.6.27";
			data = /incbin/("/mnt/ramdisk/build/openwrt/build_dir/target-aarch64_cortex-a53_musl/linux-qualcommax_ipq807x/compex_wpq873-uImage.itb");
			type = "kernel";
			arch = "arm64";
			os = "linux";
			compression = "gzip";
			load = <0x41000000>;
			entry = <0x41000000>;
			hash-1 {
				algo = "crc32";
			};
			hash-2 {
				algo = "sha1";
			};
		};


		fdt-1 {
			description = "ARM64 OpenWrt compex_wpq873 device tree blob";
			
			data = /incbin/("/mnt/ramdisk/build/openwrt/build_dir/target-aarch64_cortex-a53_musl/linux-qualcommax_ipq807x/image-ipq8072-wpq873.dtb");
			type = "flat_dt";
			
			arch = "arm64";
			compression = "none";
			hash-1 {
				algo = "crc32";
			};
			hash-2 {
				algo = "sha1";
			};
		};



	};

	configurations {
		default = "config@hk09.wpq873";
		config@hk09.wpq873 {
			description = "OpenWrt compex_wpq873";
			kernel = "kernel-1";
			fdt = "fdt-1";
			
			
			
		};
		
	};
};
```

## openwrt-imagebuilder-qualcommax-ipq807x.Linux-x86_64/build_dir/target-aarch64_cortex-a53_musl/linux-qualcommax_ipq807x/dynalink_dl-wrx36-uImage.itb.its
```
/dts-v1/;

/ {
	description = "ARM64 OpenWrt FIT (Flattened Image Tree)";
	#address-cells = <1>;

	images {
		kernel-1 {
			description = "ARM64 OpenWrt Linux-6.6.30";
			data = /incbin/("/mnt/ramdisk/build/openwrt/build_dir/target-aarch64_cortex-a53_musl/linux-qualcommax_ipq807x/dynalink_dl-wrx36-uImage.itb");
			type = "kernel";
			arch = "arm64";
			os = "linux";
			compression = "gzip";
			load = <0x41000000>;
			entry = <0x41000000>;
			hash-1 {
				algo = "crc32";
			};
			hash-2 {
				algo = "sha1";
			};
		};


		fdt-1 {
			description = "ARM64 OpenWrt dynalink_dl-wrx36 device tree blob";
			
			data = /incbin/("/mnt/ramdisk/build/openwrt/build_dir/target-aarch64_cortex-a53_musl/linux-qualcommax_ipq807x/image-ipq8072-dl-wrx36.dtb");
			type = "flat_dt";
			
			arch = "arm64";
			compression = "none";
			hash-1 {
				algo = "crc32";
			};
			hash-2 {
				algo = "sha1";
			};
		};



	};

	configurations {
		default = "config@rt5010w-d350-rev0";
		config@rt5010w-d350-rev0 {
			description = "OpenWrt dynalink_dl-wrx36";
			kernel = "kernel-1";
			fdt = "fdt-1";
			
			
			
		};
		
	};
};
```

## openwrt-imagebuilder-qualcommax-ipq807x.Linux-x86_64/build_dir/target-aarch64_cortex-a53_musl/linux-qualcommax_ipq807x/edgecore_eap102-uImage.itb.its
```
/dts-v1/;

/ {
	description = "ARM64 OpenWrt FIT (Flattened Image Tree)";
	#address-cells = <1>;

	images {
		kernel-1 {
			description = "ARM64 OpenWrt Linux-6.6.30";
			data = /incbin/("/mnt/ramdisk/build/openwrt/build_dir/target-aarch64_cortex-a53_musl/linux-qualcommax_ipq807x/edgecore_eap102-uImage.itb");
			type = "kernel";
			arch = "arm64";
			os = "linux";
			compression = "gzip";
			load = <0x41000000>;
			entry = <0x41000000>;
			hash-1 {
				algo = "crc32";
			};
			hash-2 {
				algo = "sha1";
			};
		};


		fdt-1 {
			description = "ARM64 OpenWrt edgecore_eap102 device tree blob";
			
			data = /incbin/("/mnt/ramdisk/build/openwrt/build_dir/target-aarch64_cortex-a53_musl/linux-qualcommax_ipq807x/image-ipq8071-eap102.dtb");
			type = "flat_dt";
			
			arch = "arm64";
			compression = "none";
			hash-1 {
				algo = "crc32";
			};
			hash-2 {
				algo = "sha1";
			};
		};



	};

	configurations {
		default = "config@ac02";
		config@ac02 {
			description = "OpenWrt edgecore_eap102";
			kernel = "kernel-1";
			fdt = "fdt-1";
			
			
			
		};
		
	};
};
```

## openwrt-imagebuilder-qualcommax-ipq807x.Linux-x86_64/build_dir/target-aarch64_cortex-a53_musl/linux-qualcommax_ipq807x/edimax_cax1800-uImage.itb.its
```
/dts-v1/;

/ {
	description = "ARM64 OpenWrt FIT (Flattened Image Tree)";
	#address-cells = <1>;

	images {
		kernel-1 {
			description = "ARM64 OpenWrt Linux-6.6.32";
			data = /incbin/("/mnt/ramdisk/build/openwrt/build_dir/target-aarch64_cortex-a53_musl/linux-qualcommax_ipq807x/edimax_cax1800-uImage.itb");
			type = "kernel";
			arch = "arm64";
			os = "linux";
			compression = "gzip";
			load = <0x41000000>;
			entry = <0x41000000>;
			hash-1 {
				algo = "crc32";
			};
			hash-2 {
				algo = "sha1";
			};
		};


		fdt-1 {
			description = "ARM64 OpenWrt edimax_cax1800 device tree blob";
			
			data = /incbin/("/mnt/ramdisk/build/openwrt/build_dir/target-aarch64_cortex-a53_musl/linux-qualcommax_ipq807x/image-ipq8070-cax1800.dtb");
			type = "flat_dt";
			
			arch = "arm64";
			compression = "none";
			hash-1 {
				algo = "crc32";
			};
			hash-2 {
				algo = "sha1";
			};
		};



	};

	configurations {
		default = "config@ac03";
		config@ac03 {
			description = "OpenWrt edimax_cax1800";
			kernel = "kernel-1";
			fdt = "fdt-1";
			
			
			
		};
		
	};
};
```

## openwrt-imagebuilder-qualcommax-ipq807x.Linux-x86_64/build_dir/target-aarch64_cortex-a53_musl/linux-qualcommax_ipq807x/linksys_mx4200v2-uImage.itb.its
```
/dts-v1/;

/ {
	description = "ARM64 OpenWrt FIT (Flattened Image Tree)";
	#address-cells = <1>;

	images {
		kernel-1 {
			description = "ARM64 OpenWrt Linux-6.6.32";
			data = /incbin/("/mnt/ramdisk/build/openwrt/build_dir/target-aarch64_cortex-a53_musl/linux-qualcommax_ipq807x/linksys_mx4200v2-uImage.itb");
			type = "kernel";
			arch = "arm64";
			os = "linux";
			compression = "gzip";
			load = <0x41000000>;
			entry = <0x41000000>;
			hash-1 {
				algo = "crc32";
			};
			hash-2 {
				algo = "sha1";
			};
		};


		fdt-1 {
			description = "ARM64 OpenWrt linksys_mx4200v2 device tree blob";
			
			data = /incbin/("/mnt/ramdisk/build/openwrt/build_dir/target-aarch64_cortex-a53_musl/linux-qualcommax_ipq807x/image-ipq8174-mx4200v2.dtb");
			type = "flat_dt";
			
			arch = "arm64";
			compression = "none";
			hash-1 {
				algo = "crc32";
			};
			hash-2 {
				algo = "sha1";
			};
		};



	};

	configurations {
		default = "config@1";
		config@1 {
			description = "OpenWrt linksys_mx4200v2";
			kernel = "kernel-1";
			fdt = "fdt-1";
			
			
			
		};
		
	};
};
```

## openwrt-imagebuilder-qualcommax-ipq807x.Linux-x86_64/build_dir/target-aarch64_cortex-a53_musl/linux-qualcommax_ipq807x/netgear_sxs80-uImage.itb.its
```
/dts-v1/;

/ {
	description = "ARM64 OpenWrt FIT (Flattened Image Tree)";
	#address-cells = <1>;

	images {
		kernel-1 {
			description = "ARM64 OpenWrt Linux-6.6.32";
			data = /incbin/("/mnt/ramdisk/build/openwrt/build_dir/target-aarch64_cortex-a53_musl/linux-qualcommax_ipq807x/netgear_sxs80-uImage.itb");
			type = "kernel";
			arch = "arm64";
			os = "linux";
			compression = "gzip";
			load = <0x41000000>;
			entry = <0x41000000>;
			hash-1 {
				algo = "crc32";
			};
			hash-2 {
				algo = "sha1";
			};
		};


		fdt-1 {
			description = "ARM64 OpenWrt netgear_sxs80 device tree blob";
			
			data = /incbin/("/mnt/ramdisk/build/openwrt/build_dir/target-aarch64_cortex-a53_musl/linux-qualcommax_ipq807x/image-ipq8074-sxs80.dtb");
			type = "flat_dt";
			
			arch = "arm64";
			compression = "none";
			hash-1 {
				algo = "crc32";
			};
			hash-2 {
				algo = "sha1";
			};
		};



	};

	configurations {
		default = "config@hk01";
		config@hk01 {
			description = "OpenWrt netgear_sxs80";
			kernel = "kernel-1";
			fdt = "fdt-1";
			
			
			
		};
		
	};
};
```

## openwrt-imagebuilder-qualcommax-ipq807x.Linux-x86_64/build_dir/target-aarch64_cortex-a53_musl/linux-qualcommax_ipq807x/netgear_wax620-uImage.itb.its
```
/dts-v1/;

/ {
	description = "ARM64 OpenWrt FIT (Flattened Image Tree)";
	#address-cells = <1>;

	images {
		kernel-1 {
			description = "ARM64 OpenWrt Linux-6.6.27";
			data = /incbin/("/mnt/ramdisk/build/openwrt/build_dir/target-aarch64_cortex-a53_musl/linux-qualcommax_ipq807x/netgear_wax620-uImage.itb");
			type = "kernel";
			arch = "arm64";
			os = "linux";
			compression = "gzip";
			load = <0x41000000>;
			entry = <0x41000000>;
			hash-1 {
				algo = "crc32";
			};
			hash-2 {
				algo = "sha1";
			};
		};


		fdt-1 {
			description = "ARM64 OpenWrt netgear_wax620 device tree blob";
			
			data = /incbin/("/mnt/ramdisk/build/openwrt/build_dir/target-aarch64_cortex-a53_musl/linux-qualcommax_ipq807x/image-ipq8072-wax620.dtb");
			type = "flat_dt";
			
			arch = "arm64";
			compression = "none";
			hash-1 {
				algo = "crc32";
			};
			hash-2 {
				algo = "sha1";
			};
		};



	};

	configurations {
		default = "config@hk07";
		config@hk07 {
			description = "OpenWrt netgear_wax620";
			kernel = "kernel-1";
			fdt = "fdt-1";
			
			
			
		};
		
	};
};
```

## openwrt-imagebuilder-qualcommax-ipq807x.Linux-x86_64/build_dir/target-aarch64_cortex-a53_musl/linux-qualcommax_ipq807x/prpl_haze-uImage.itb.its
```
/dts-v1/;

/ {
	description = "ARM64 OpenWrt FIT (Flattened Image Tree)";
	#address-cells = <1>;

	images {
		kernel-1 {
			description = "ARM64 OpenWrt Linux-6.6.30";
			data = /incbin/("/mnt/ramdisk/build/openwrt/build_dir/target-aarch64_cortex-a53_musl/linux-qualcommax_ipq807x/prpl_haze-uImage.itb");
			type = "kernel";
			arch = "arm64";
			os = "linux";
			compression = "gzip";
			load = <0x41000000>;
			entry = <0x41000000>;
			hash-1 {
				algo = "crc32";
			};
			hash-2 {
				algo = "sha1";
			};
		};


		fdt-1 {
			description = "ARM64 OpenWrt prpl_haze device tree blob";
			
			data = /incbin/("/mnt/ramdisk/build/openwrt/build_dir/target-aarch64_cortex-a53_musl/linux-qualcommax_ipq807x/image-ipq8072-haze.dtb");
			type = "flat_dt";
			
			arch = "arm64";
			compression = "none";
			hash-1 {
				algo = "crc32";
			};
			hash-2 {
				algo = "sha1";
			};
		};



	};

	configurations {
		default = "config@hk09";
		config@hk09 {
			description = "OpenWrt prpl_haze";
			kernel = "kernel-1";
			fdt = "fdt-1";
			
			
			
		};
		
	};
};
```

## openwrt-imagebuilder-qualcommax-ipq807x.Linux-x86_64/build_dir/target-aarch64_cortex-a53_musl/linux-qualcommax_ipq807x/qnap_301w-uImage.itb.its
```
/dts-v1/;

/ {
	description = "ARM64 OpenWrt FIT (Flattened Image Tree)";
	#address-cells = <1>;

	images {
		kernel-1 {
			description = "ARM64 OpenWrt Linux-6.6.27";
			data = /incbin/("/mnt/ramdisk/build/openwrt/build_dir/target-aarch64_cortex-a53_musl/linux-qualcommax_ipq807x/qnap_301w-uImage.itb");
			type = "kernel";
			arch = "arm64";
			os = "linux";
			compression = "gzip";
			load = <0x41000000>;
			entry = <0x41000000>;
			hash-1 {
				algo = "crc32";
			};
			hash-2 {
				algo = "sha1";
			};
		};


		fdt-1 {
			description = "ARM64 OpenWrt qnap_301w device tree blob";
			
			data = /incbin/("/mnt/ramdisk/build/openwrt/build_dir/target-aarch64_cortex-a53_musl/linux-qualcommax_ipq807x/image-ipq8072-301w.dtb");
			type = "flat_dt";
			
			arch = "arm64";
			compression = "none";
			hash-1 {
				algo = "crc32";
			};
			hash-2 {
				algo = "sha1";
			};
		};



	};

	configurations {
		default = "config@hk01";
		config@hk01 {
			description = "OpenWrt qnap_301w";
			kernel = "kernel-1";
			fdt = "fdt-1";
			
			
			
		};
		
	};
};
```

## openwrt-imagebuilder-qualcommax-ipq807x.Linux-x86_64/build_dir/target-aarch64_cortex-a53_musl/linux-qualcommax_ipq807x/spectrum_sax1v1k-uImage.itb.its
```
/dts-v1/;

/ {
	description = "ARM64 OpenWrt FIT (Flattened Image Tree)";
	#address-cells = <1>;

	images {
		kernel-1 {
			description = "ARM64 OpenWrt Linux-6.6.32";
			data = /incbin/("/mnt/ramdisk/build/openwrt/build_dir/target-aarch64_cortex-a53_musl/linux-qualcommax_ipq807x/spectrum_sax1v1k-uImage.itb");
			type = "kernel";
			arch = "arm64";
			os = "linux";
			compression = "gzip";
			load = <0x41000000>;
			entry = <0x41000000>;
			hash-1 {
				algo = "crc32";
			};
			hash-2 {
				algo = "sha1";
			};
		};


		fdt-1 {
			description = "ARM64 OpenWrt spectrum_sax1v1k device tree blob";
			
			data = /incbin/("/mnt/ramdisk/build/openwrt/build_dir/target-aarch64_cortex-a53_musl/linux-qualcommax_ipq807x/image-ipq8072-sax1v1k.dtb");
			type = "flat_dt";
			
			arch = "arm64";
			compression = "none";
			hash-1 {
				algo = "crc32";
			};
			hash-2 {
				algo = "sha1";
			};
		};



	};

	configurations {
		default = "config@rt5010w-d187-rev6";
		config@rt5010w-d187-rev6 {
			description = "OpenWrt spectrum_sax1v1k";
			kernel = "kernel-1";
			fdt = "fdt-1";
			
			
			
		};
		
	};
};
```
